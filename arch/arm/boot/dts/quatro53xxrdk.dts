/*
 * DTS file for Quatro 5300 RDK Controller Board
 *
 * Copyright (c) 2014, 2015, The Linux Foundation. All rights reserved.
 *
 * This program is free software; you can redistribute it and/or modify
 * it under the terms of the GNU General Public License version 2 and
 * only version 2 as published by the Free Software Foundation.
 *
 * This program is distributed in the hope that it will be useful,
 * but WITHOUT ANY WARRANTY; without even the implied warranty of
 * MERCHANTABILITY or FITNESS FOR A PARTICULAR PURPOSE.  See the
 * GNU General Public License for more details.
 *
 */

/dts-v1/;

/include/ "quatro5300.dtsi"

/ {
	model = "Quatro 5300 RDK Controller Board";
	compatible = "csr,quatro-5300";

	chosen {
	       bootargs = "root=/dev/mtdblock4 rw rootwait console=ttyS0,115200n8 break=y";
	};

	memory {
		reg = <0x00000000 0x20000000>;
	};	
};
